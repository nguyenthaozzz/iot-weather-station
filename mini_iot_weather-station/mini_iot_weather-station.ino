#include <WiFi.h>
#include <PubSubClient.h>
#include <DHT.h>
#include <ArduinoJson.h>
#include <Wire.h>
#include <Adafruit_Sensor.h>
#include <Adafruit_BMP085_U.h>
#include <HTTPClient.h>         
#include <WiFiClientSecure.h> 
//--------------- Thư viện màn hình TFT -----------
#include <Adafruit_GFX.h>
#include <Adafruit_ST7735.h>
#include <SPI.h>
//--------------- Thư viện thời gian --------------
#include <NTPClient.h>
#include <WiFiUdp.h>
#include <SimpleTimer.h>

//----------- Khai báo chân kết nối màn hình TFT ---------------

#define TFT_CS    5     // GPIO5  → CS
#define TFT_RST   6     // GPIO6  → RESET
#define TFT_DC    7     // GPIO7  → DC
#define TFT_MOSI  8     // GPIO8  → MOSI
#define TFT_SCLK  9     // GPIO9  → SCK

// Khởi tạo màn hình TFT ST7735
Adafruit_ST7735 tft = Adafruit_ST7735(TFT_CS, TFT_DC, TFT_MOSI, TFT_SCLK, TFT_RST);

//------------Dinh nghia mau sac----------------
#define BLACK 0x0000    
#define BLUE 0x001F    
#define RED 0xF800      
#define GREEN 0x07E0
#define CYAN 0x07FF
#define MAGENTA 0xF81F  
#define YELLOW 0xFFE0
#define WHITE 0xFFFF 
//-------------Bitmap Logo ICON hien thi LCD-------------------------------------------
// 'logo_ute', 50x50px
const uint16_t logo_ute [] PROGMEM = {
	0xfffc, 0xfffe, 0xffff, 0xffff, 0xffdf, 0xffdf, 0xffdf, 0xffdf, 0xffff, 0xffff, 0xffff, 0xffff, 0xffff, 0xffdf, 0xffdf, 0xffff, 
	0xf7bf, 0xe75e, 0xcefc, 0xc6db, 0xadb7, 0xbd97, 0xc536, 0xcd57, 0xb597, 0xa596, 0xae18, 0xadf8, 0xa597, 0xb5f9, 0xce5b, 0xd69c, 
	0xef1d, 0xffbf, 0xffff, 0xffdf, 0xffdf, 0xffdf, 0xffdf, 0xffdf, 0xffdf, 0xffff, 0xffff, 0xffbf, 0xffdf, 0xffff, 0xffff, 0xffff, 
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	0xffdf, 0xffff, 0xffff, 0xffdf
};

// Array of all bitmaps for convenience. (Total bytes used to store images in PROGMEM = 2528)
const int logoallArray_LEN = 1;
const uint16_t* logoallArray[1] = {
	logo_ute
};
static const uint8_t temperature[] = {
  0x00, 0x00, 0x00, 0x00, 0x47, 0x00, 0x00, 0x4c, 0x80, 0x00, 0x48, 0xc0, 0x18, 0x0a, 0x70, 0x09, 
  0xfa, 0x70, 0x03, 0x1a, 0x40, 0x06, 0x0a, 0x70, 0x04, 0x0a, 0xc0, 0x0c, 0x0a, 0x70, 0xec, 0x0a, 
  0xc0, 0x04, 0x0a, 0x40, 0x04, 0x13, 0x60, 0x02, 0x17, 0xa0, 0x01, 0xf7, 0x20, 0x08, 0x5a, 0x60, 
  0x18, 0x0c, 0xc0, 0x00, 0x47, 0x80, 0x00, 0x40, 0x00, 0x00, 0x40, 0x00
};
static const uint8_t humidity[] = {
  0x00, 0x00, 0x00, 0x00, 0x60, 0x00, 0x00, 0x60, 0x00, 0x00, 0xd0, 0x00, 0x01, 0x98, 0x00, 0x03, 
  0x0c, 0x00, 0x06, 0x06, 0x00, 0x04, 0x03, 0x00, 0x08, 0x01, 0x00, 0x18, 0x01, 0x80, 0x10, 0x00, 
  0x80, 0x10, 0x00, 0xc0, 0x14, 0x00, 0xc0, 0x14, 0x00, 0xc0, 0x16, 0x00, 0x80, 0x1b, 0x00, 0x80, 
  0x09, 0xf1, 0x00, 0x0c, 0xf3, 0x00, 0x07, 0x0e, 0x00, 0x01, 0xf8, 0x00
};
// 'pressure', 20x20px
const unsigned char pressure [] PROGMEM = {
	0x03, 0xfc, 0x00, 0x07, 0xfe, 0x00, 0x1f, 0x0f, 0x80, 0x3c, 0x03, 0xc0, 0x30, 0x01, 0xc0, 0x70, 
	0x60, 0xe0, 0xe0, 0x60, 0x60, 0xe0, 0x60, 0x70, 0xc0, 0x60, 0x30, 0xc0, 0x60, 0x30, 0xc0, 0x60, 
	0x30, 0xc0, 0x38, 0x30, 0xe0, 0x1e, 0x70, 0xe0, 0x06, 0x70, 0x70, 0x00, 0xe0, 0x70, 0x00, 0xe0, 
	0x3c, 0x03, 0xc0, 0x1f, 0x0f, 0x80, 0x07, 0xfe, 0x00, 0x03, 0xfc, 0x00
};

// Array of all bitmaps for convenience. (Total bytes used to store images in PROGMEM = 80)
const int pressureallArray_LEN = 1;
const unsigned char* pressureallArray[1] = {
	pressure
};
const static unsigned char icondo[]= {
  0x00, 0x00, 0x3f, 0x00, 0x3f, 0x00, 0x33, 0x00, 0x33, 0x00, 0x3f, 0x00, 0x3f, 0x00, 0x00, 0x00, 
  0x00, 0x00, 0x00, 0x00, 0x00, 0x00, 0x00, 0x00, 0x00, 0x00, 0x00, 0x00, 0x00, 0x00, 0x00, 0x00, 
  0x00, 0x00, 0x00, 0x00, 0x00, 0x00, 0x00, 0x00
};
const unsigned char rain [] = {
  0x00, 0x00, 0x00, 0x00, 0x00, 0x00, 0x00, 0x00, 0x00, 0x00, 0x00, 0x00, 0x00, 0x00, 0x00, 0x00, 
  0x00, 0x00, 0x00, 0x00, 0x00, 0x00, 0x00, 0x00, 0x00, 0x00, 0x00, 0x00, 0x00, 0x00, 0xff, 0xe0, 
  0x00, 0x00, 0x00, 0x00, 0x07, 0x80, 0x78, 0x00, 0x00, 0x00, 0x00, 0x06, 0x00, 0x1c, 0x00, 0x00, 
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  0x00, 0x00, 0x00, 0x00, 0x00, 0x00, 0x00, 0x00
};
const unsigned char cloudy [] = {
  0x00, 0x00, 0x00, 0x00, 0x00, 0x00, 0x00, 0x00, 0x00, 0x00, 0x00, 0x00, 0x00, 0x00, 0x00, 0x00, 
  0x00, 0x00, 0x00, 0x00, 0x00, 0x00, 0x00, 0x00, 0x00, 0x00, 0x00, 0x00, 0x00, 0x00, 0x00, 0x00, 
  0x00, 0x00, 0x00, 0x00, 0x00, 0x1c, 0x00, 0x00, 0x00, 0x00, 0x00, 0x00, 0xff, 0x00, 0x00, 0x00, 
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  0x00, 0x00, 0x00, 0x00, 0x00, 0x00, 0x00, 0x00, 0x00, 0x00, 0x00, 0x00, 0x00, 0x00, 0x00, 0x00, 
  0x00 
};
const unsigned char lighting [] = {
  0x00, 0x00, 0x00, 0x00, 0x00, 0x00, 0x00, 0x00, 0x00, 0x00, 0x00, 0x00, 0x00, 0x00, 0x00, 0x00, 
  0x00, 0x00, 0x00, 0x00, 0x00, 0x00, 0x00, 0xff, 0xc0, 0x00, 0x00, 0x00, 0x00, 0x03, 0xc0, 0xf8, 
  0x00, 0x00, 0x00, 0x00, 0x06, 0x00, 0x0e, 0x00, 0x00, 0x00, 0x00, 0x0c, 0x00, 0x06, 0x00, 0x00, 
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  0x00, 0x00, 0x00, 0x00, 0x00, 0x00, 0x00, 0x00 
};
const unsigned char lighting_rain [] = {
  0x00, 0x00, 0x00, 0x00, 0x00, 0x00, 0x00, 0x00, 0x00, 0x00, 0x00, 0x00, 0x00, 0x00, 0x00, 0x00, 
  0x00, 0x00, 0x00, 0x00, 0x00, 0x00, 0x00, 0x00, 0x00, 0x00, 0x00, 0x00, 0x00, 0x00, 0x3f, 0xff, 
  0x00, 0x00, 0x00, 0x00, 0x00, 0xe0, 0x01, 0xc0, 0x00, 0x00, 0x00, 0x01, 0xc0, 0x00, 0xe0, 0x00, 
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  0x00, 0x00, 0x00, 0x00, 0x00, 0x00, 0x00, 0x00 
};
const unsigned char night [] = {
  0x00, 0x00, 0x00, 0x00, 0x00, 0x00, 0x00, 0x00, 0x00, 0x00, 0x00, 0x00, 0x00, 0x00, 0x00, 0x00, 
  0x00, 0x10, 0x00, 0x00, 0x00, 0x00, 0x00, 0x00, 0x1c, 0x00, 0x00, 0x00, 0x00, 0x00, 0x00, 0x1f, 
  0x00, 0x00, 0x00, 0x00, 0x00, 0x00, 0x0f, 0xc0, 0x00, 0x00, 0x00, 0x00, 0x00, 0x0f, 0xc0, 0x00, 
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  0x00, 0x00, 0x00, 0x00, 0x00, 0x00, 0x00, 0x00, 
};
const unsigned char clear_sky [] = {
  0x00, 0x00, 0x00, 0x00, 0x00, 0x00, 0x00, 0x00, 0x00, 0x00, 0x00, 0x00, 0x00, 0x00, 0x00, 0x00, 
  0x03, 0xc0, 0x00, 0x00, 0x00, 0x00, 0x00, 0x03, 0xc0, 0x00, 0x00, 0x00, 0x00, 0x00, 0x03, 0xc0, 
  0x00, 0x00, 0x00, 0x00, 0x00, 0x03, 0xc0, 0x00, 0x00, 0x00, 0x00, 0x38, 0x03, 0xc0, 0x1c, 0x00, 
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  0x00, 0x00, 0x00, 0x00, 0x00, 0x00, 0x00, 0x00 
};
 
const unsigned char clear_cloudy [] = {
  0x00, 0x00, 0x00, 0x00, 0x00, 0x00, 0x00, 0x00, 0x00, 0x00, 0x06, 0x00, 0x00, 0x00, 0x00, 0x00, 
  0x00, 0x06, 0x00, 0x00, 0x00, 0x00, 0x00, 0x03, 0x06, 0x00, 0x00, 0x00, 0x00, 0x00, 0x03, 0x06, 
  0x0c, 0x00, 0x00, 0x00, 0x00, 0x01, 0x86, 0x1c, 0x00, 0x00, 0x00, 0x00, 0x01, 0xc0, 0x18, 0x00, 
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  0x00, 0x00, 0x00, 0x00, 0x00, 0x00, 0x00, 0x00
};
const unsigned char night_cloud [] = {
  0x00, 0x00, 0x00, 0x00, 0x00, 0x00, 0x00, 0x00, 0x00, 0x00, 0x00, 0x00, 0x00, 0x00, 0x00, 0x00, 
  0x00, 0x00, 0x00, 0x00, 0x00, 0x00, 0x00, 0x00, 0x00, 0x00, 0x00, 0x00, 0x00, 0x00, 0x00, 0x01, 
  0xe0, 0x00, 0x00, 0x00, 0x00, 0x00, 0x07, 0xf8, 0x00, 0x00, 0x00, 0x00, 0x00, 0x0e, 0x3c, 0x00, 
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  0x00, 0x00, 0x00, 0x00, 0x00, 0x00, 0x00, 0x00 
};
// Define NTP Client to get time
WiFiUDP ntpUDP;
NTPClient timeClient(ntpUDP, "pool.ntp.org");
//Week Days
String weekDays[7]={"Sunday", "Monday", "Tuesday", "Wednesday", "Thursday", "Friday", "Saturday"};
int gio, phut, giay, thu, ngay, thang, nam;
SimpleTimer timer_updateTime;
//-----------------------Phan khai bao cho Thoi tiet----------------------------------------------
//--------------Thoi tiet--------------
// 🌐 Cấu hình API OpenWeatherMap
String apiKey = "your API Key";  // 🔑 API Key của bạn
String city = "Ho Chi Minh";                         // 🏙️ Thành phố cần lấy dữ liệu

// 🌡️ Biến lưu dữ liệu thời tiết
float nhiet_do, ap_suat ;
int do_am, thoitiet;

// 🌍 Không cần lat, lon, hay server[] nữa
HTTPClient http;
//===================================================================
// ======== Biến toàn cục ========
// ====== Biến cho dữ liệu thời tiết từ API ======
String weather_text = "";
String weather_icon = "";
int weather_code = 0;

unsigned long previousMillis = 0;
const long interval = 1000; // 1 giây

// ====== Wi-Fi credentials ======
const char* ssid = "ESP32";       //sửa theo wifi lúc đó    asusvivobook     Timmie's S21 FE
const char* password = "12345678";               //                         45456789        @18022005

// ====== MQTT Broker details ======
const char* mqttServer = "192.168.12.206"; // IP broker theo lúc đó   10.0.26.216     10.95.221.206
const int mqttPort = 1883;
const char* mqttUser = ""; 
const char* mqttPassword = ""; 
const char* clientId = "ESP32_CLIENT";

// ====== MQTT Topics ======
const char* dataTopic = "home/sensor/data";   // publish DHT + BMP
const char* commandTopic = "iot/house/commands"; // sub nhận lệnh

bool lcdSleeping = false;

// ====== DHT11 Sensor ======
#define DHTPIN 4
#define DHTTYPE DHT11
DHT dht(DHTPIN, DHTTYPE);

// ====== BMP180/BMP085 Sensor ======
Adafruit_BMP085_Unified bmp = Adafruit_BMP085_Unified(10085);

// ====== WiFi + MQTT client ======
WiFiClient espClient;
PubSubClient client(espClient);

void setup_wifi() {
  delay(10);
  Serial.println("Connecting to WiFi...");
  WiFi.begin(ssid, password);
  delay(5000);
  if (WiFi.status() == WL_CONNECTED) {
    Serial.println("\n✅ Connected to WiFi!");
    Serial.print("IP Address: ");
    Serial.println(WiFi.localIP());
  } else {
    Serial.println("\n⚠️ WiFi not connected. Running offline mode.");
  }
}

void reconnect() {
  static unsigned long lastReconnectAttempt = 0;

  if (client.connected()) {
    // Nếu trước đó chưa vẽ trạng thái OK, thì vẽ ngay
    // (Điều này chỉ xảy ra một lần ngay sau khi kết nối thành công)
    if (lastReconnectAttempt != 0) {
      drawMQTTStatus();
      lastReconnectAttempt = 0; // Reset lại để biết là đang ổn định
    }
    return;
  }
  
  unsigned long now = millis();
  
  // Điều kiện mới: Thử kết nối nếu đây là lần đầu hoặc đã qua 30 giây
  if (lastReconnectAttempt == 0 || now - lastReconnectAttempt > 30000) {
    
    if (lastReconnectAttempt != 0) {
      Serial.println("MQTT connection lost. Reconnecting...");
    }
    
    lastReconnectAttempt = now;
    Serial.print("Attempting MQTT connection... ");

    if (client.connect(clientId, mqttUser, mqttPassword)) {
      Serial.println("✅ success");
      client.subscribe(commandTopic);
    } else {
      Serial.print("❌ failed, rc=");
      Serial.print(client.state());
      Serial.println(" | Retrying in 30 seconds...");
    }
    
    // Luôn vẽ trạng thái mới sau mỗi lần thử
    drawMQTTStatus();
  }
}


////////////// Tắt màn hình LCD//////////
void lcdSleep() {
  if (lcdSleeping) return; // đã sleep rồi
  lcdSleeping = true;

  // Tô đen toàn màn hình (double clear để chắc chắn)
  tft.fillScreen(BLACK);
  delay(40);
  tft.fillScreen(BLACK);
  delay(20);

  // Gửi lệnh vào chế độ sleep (vẫn giữ kết nối WiFi/MQTT)
  tft.writeCommand(ST77XX_DISPOFF);
  tft.writeCommand(ST77XX_SLPIN);

  Serial.println("🛌 LCD OFF (sleep) - blacked out");
}
////////////// Bật màn hình LCD//////////
void lcdWake() {
  if (!lcdSleeping) return; // đã wake rồi

  // Gửi lệnh vào chế độ sleep (vẫn giữ kết nối WiFi/MQTT)
  // tft.writeCommand(ST77XX_DISPOFF); // Bạn có thể bỏ qua các lệnh này nếu
  // tft.writeCommand(ST77XX_SLPIN);   // thực sự chỉ tô đen màn hình

  lcdSleeping = false; // Bật cờ trước khi vẽ

  // Vẽ lại toàn bộ giao diện tĩnh
  setupLCD();
  
  // Cập nhật lại những thứ không cần mạng
  updateSensorData(); 
  
  // Vẽ lại icon thời tiết với dữ liệu đã có
  tft.fillRect(78, 99, 50, 40, BLACK);
  iconthoitiet(78, 99, weather_code);

  // Cập nhật trạng thái MQTT
  drawMQTTStatus();

  Serial.println("🌞 LCD ON (wake) - UI restored");
}

void callback(char* topic, byte* payload, unsigned int length) {
  Serial.print("Message arrived on topic: ");
  Serial.print(topic);
  Serial.print(" | Message: ");
  String message = "";
  for (int i = 0; i < length; i++) {
    message += (char)payload[i];
  }
  Serial.println(message);

  if (String(topic) == commandTopic) {
    // ================= LCD Commands =================
    if (message == "OPEN") {
      Serial.println("👉 Command: OPEN LCD");
      lcdWake();
      client.publish("iot/house/status", "LCD OPENED");
      return;
    } 
    if (message == "SLEEP") {
      Serial.println("👉 Command: SLEEP LCD");
      lcdSleep();
      client.publish("iot/house/status", "LCD SLEPT");
      return;
    }

    // ================= City Change Command =================
    // Nếu message là JSON, ví dụ {"cmd":"change_city","city":"Da Nang"}
    DynamicJsonDocument doc(256);
    DeserializationError error = deserializeJson(doc, message);
    if (!error) {
      String cmd = doc["cmd"];
      if (cmd == "change_city") {
        String newCity = doc["city"].as<String>();
        if (newCity.length() > 0) {
          city = newCity;
          Serial.println("🌍 Nhận lệnh đổi vị trí sang: " + city);

          // Cập nhật ngay dữ liệu thời tiết
          getWeather();

          // Gửi phản hồi về server để biết đã đổi
          client.publish("iot/house/status", ("CITY_CHANGED:" + city).c_str());
        }
      }
    } else {
      Serial.println("⚠️ Lệnh không phải JSON hoặc lỗi parse!");
    }
  }
}



//==================================================================================== MAIN ===================================================================================================================================================
bool check_wifi = 0;
// Trạng thái màn hình (true = đang sleep / blacked-out)
void drawMQTTStatus() {
  if (lcdSleeping) return;
  // Vùng status tương ứng với layout hiện tại
  const int x = 96, y = 42, w = 30, h = 10;
  // Xóa vùng trước khi in
  tft.fillRect(x, y, w, h, BLACK);
  tft.setCursor(x, y);
  tft.setTextSize(1);

  if (client.connected()) {
    tft.setTextColor(GREEN, BLACK);
    tft.print("OK");
  } else {
    tft.setTextColor(RED, BLACK);
    tft.print("LOST");
  }
}

void setup() {
  Serial.begin(115200);
  Serial.println();
  Serial.println("=== Bắt đầu khởi động hệ thống ===");
  // Khởi tạo I2C trên ESP32-C6 (SDA=11, SCL=12)
  Wire.begin(11, 12);

  // Khởi động DHT11
  dht.begin();
  
  // Khởi động BMP180
  if (!bmp.begin()) {
    Serial.println("❌ Could not find a valid BMP085/BMP180 sensor, check_wifi wiring!");
    while (1);
  }

  setup_wifi();
  client.setServer(mqttServer, mqttPort);
  client.setBufferSize(512);            // giúp tránh nghẽn khi gói JSON dài hơn mặc định 128 byte
  client.setCallback(callback);
  client.subscribe(commandTopic);
  tft.initR(INITR_BLACKTAB);//Thiet lap LCD TFT
  tft.setSPISpeed(27000000); // 27 MHz
  setupLCD();                                     //Thiet lap Hien thi LCD
  drawMQTTStatus();
  timeClient.begin();                             //Khoi chay lay thoi gian tu NTP
  timeClient.setTimeOffset(25200);    //Cai dat mui gio GMT+7

  if(WiFi.status() == WL_CONNECTED){    // chỉ hiện thời gian và API khi có kết nối wifi
    check_wifi = 1;
    getThoigian();                                  //Lay thoi gian tren NTP  
    updateTimeLCD();
    getWeather();
  }
  updateSensorData();
  
}

unsigned long previousPublish = 0;
unsigned long previousSensor = 0;
unsigned long previousWeatherUpdate = 0; // << Thêm dòng này
/////////////////////////////////////////////////////////////////////////////
void loop() {
  // ===== 1. Xử lý kết nối WiFi & MQTT =====
  if (WiFi.status() == WL_CONNECTED) {
    if (check_wifi == 0) { // Nếu trước đó không có mạng, bây giờ đã có
      check_wifi = 1;
      Serial.println("WiFi reconnected. Initializing network services...");
      ESP.restart();   // 🔄 Reset ESP32
    }
    reconnect(); // Xử lý MQTT tự động
  } else {
    if (check_wifi == 1) { // Nếu trước đó có mạng, bây giờ bị mất
      check_wifi = 0;
      Serial.println("WiFi connection lost.");
      drawMQTTStatus(); // Hiển thị trạng thái mất mạng
    }
  }

  // ===== 2. Xử lý các gói tin MQTT đến và đi =====
  client.loop();

  unsigned long currentMillis = millis();

  // ===== 3. Cập nhật thời gian mỗi 1s =====
  if (currentMillis - previousMillis >= 1000 && check_wifi == 1) {
    previousMillis = currentMillis;
    timeClient.update();
    getThoigian();
    updateTimeLCD();
  }

  // ===== 4. Đọc cảm biến mỗi 0.5s =====
  if (currentMillis - previousSensor >= 500) {
    previousSensor = currentMillis;
    updateSensorData();
  }

  // ===== 5. Publish MQTT mỗi 0.5s =====
  if (client.connected() && (currentMillis - previousPublish >= 500)) {
    previousPublish = currentMillis;

    StaticJsonDocument<256> doc;
    doc["temperature_dht"] = nhiet_do;
    doc["humidity"] = do_am;
    doc["pressure"] = ap_suat;
    doc["weather_code"] = weather_code;

    // === Thêm timestamp Epoch để Influx ghi đúng thời điểm thực ===
    doc["timestamp"] = timeClient.getEpochTime();

    String jsonString;
    serializeJson(doc, jsonString);

    // Gửi MQTT
    client.publish(dataTopic, jsonString.c_str());
    Serial.print("✅ Published data: ");
    Serial.println(jsonString);
  }

  // ===== 6. Cập nhật dữ liệu thời tiết API mỗi 30 phút =====
  if (currentMillis - previousWeatherUpdate >= 1800000UL && WiFi.status() == WL_CONNECTED) {
    previousWeatherUpdate = currentMillis;
    getWeather();
  }
}



//=====================Phan chuong trinh con===============================
void updateSensorData() {
  if (lcdSleeping) return; // nếu đang sleep thì không vẽ
  float hum11 = dht.readHumidity();
  float temp11 = dht.readTemperature();
  sensors_event_t event;
  bmp.getEvent(&event);


  float apsuat = event.pressure ? event.pressure : 0;
  if (isnan(hum11) || isnan(temp11)) {
    Serial.println("⚠️ Lỗi đọc cảm biến DHT11!");
    return;
  }

  nhiet_do = (int)temp11;
  do_am = (int)hum11;
  ap_suat = (int)apsuat;
  Serial.printf("🌡 Nhiệt độ: %.1f°C | 💧 Độ ẩm: %.1f%%\n", temp11, hum11);

  // === Hiển thị lên TFT ===
  tft.setCursor(35, 94);
  tft.setTextColor(YELLOW, BLACK);
  tft.setTextSize(2);
  tft.print((int)nhiet_do);
  tft.drawBitmap(57, 94, icondo, 10, 20, YELLOW);
  tft.setCursor(68, 94);
  tft.print("C");

  tft.setCursor(35, 118);
  tft.setTextColor(GREEN, BLACK);
  tft.setTextSize(2);
  tft.print(String(do_am) + "%");

  tft.setCursor(35, 140);
  tft.setTextColor(GREEN, BLACK);
  tft.setTextSize(2);
  tft.print((int)ap_suat);
}

void setupLCD(){
  tft.fillScreen(BLACK);                          //Thiet lap mau nen LCD
  tft.drawRGBBitmap(2, 2, logo_ute, 50, 50);
  printText("WEATHER",CYAN,60,5,1);         //Hien thi thong tin kenh
  printText("STATION",CYAN,60,17,1);
  printText("NHOM 9",YELLOW,60,30,1);
  printText("MQTT: ",GREEN,60,42,1);
  tft.drawRect(0,65,128,25,MAGENTA);              //Hien thi khung thoi gian
  tft.drawBitmap(10,92,temperature,20,20,CYAN);  //Hien thi icon nhiet do va do am
  tft.drawBitmap(10,114,humidity,20,20,CYAN);
  tft.drawBitmap(10,136,pressure,20,20,CYAN);
}
void getThoigian(){
  gio  = timeClient.getHours();
  phut = timeClient.getMinutes();
  giay = timeClient.getSeconds();
  Serial.println();
  Serial.printf("%02d:%02d:%02d",gio,phut,giay);
  thu  = timeClient.getDay();
  unsigned long epochTime = timeClient.getEpochTime();
  struct tm *ptm = gmtime ((time_t *)&epochTime); 
  ngay  = ptm->tm_mday;
  thang = ptm->tm_mon+1;     //1-->11;
  nam   = ptm->tm_year+1900;
  Serial.println();
  Serial.printf("Thu %0d Ngay %02d Thang %02d Nam %d",thu, ngay, thang, nam);
}

void updateTimeLCD(){ 
  if (lcdSleeping) return; // nếu đang sleep thì không vẽ
  if (nam < 2024 || nam > 4000) return;
  //Hien thi thu trong tuan
  tft.setCursor(5, 55);
  tft.setTextColor(YELLOW,BLACK);
  tft.setTextSize(1);
  String weekDay = weekDays[thu];
  tft.print(weekDay);
  
  //Print complete date:
  tft.setCursor(65, 55);
  tft.setTextColor(CYAN,BLACK);
  tft.setTextSize(1);
  String ngay_,thang_;
  if(ngay<10){
    ngay_= "0" + String(ngay);
  }else{
    ngay_=String(ngay);
  }
  if(thang<10){
    thang_= "0" + String(thang);
  }else{
    thang_=String(thang);
  }
  String currentDate = ngay_ + "-" + thang_ + "-" + String(nam);
  tft.println(currentDate);
  // Hiển thị thời gian
  tft.setCursor(15, 70);
  tft.setTextColor(WHITE,BLACK);
  tft.setTextSize(2);
  String gio_,phut_,giay_;
  if(gio<10){
    gio_= "0" + String(gio);
  }else{
    gio_=String(gio);
  }
  if(phut<10){
    phut_= "0" + String(phut);
  }else{
    phut_=String(phut);
  }
  if(giay<10){
    giay_= "0" + String(giay);
  }else{
    giay_=String(giay);
  }
  String formattedTime = gio_ + ":" + phut_ + ":" + giay_;
  tft.print(formattedTime);
  
}

void getWeather() {
  String cityEncoded = city;
  cityEncoded.replace(" ", "%20");

  WiFiClientSecure client;
  client.setInsecure();

  HTTPClient http;
  String url = "https://api.openweathermap.org/data/2.5/weather?q=" + cityEncoded +
               "&appid=" + apiKey + "&units=metric";

  Serial.println("[HTTP] Đang truy cập API:");
  Serial.println(url);

  http.begin(client, url);
  http.addHeader("User-Agent", "ESP32C6-WeatherClient");
  http.addHeader("Content-Type", "application/json");

  int httpCode = http.GET();
  if (httpCode > 0) {
    if (httpCode == HTTP_CODE_OK) {
      String data = http.getString();
      DynamicJsonDocument doc(2048);
      DeserializationError error = deserializeJson(doc, data);
      if (error) {
        Serial.print("❌ JSON parse error: ");
        Serial.println(error.f_str());
        return;
      }

      // ✅ Lưu các thông tin từ API
      weather_code = doc["weather"][0]["id"].as<int>();
      weather_text = doc["weather"][0]["main"].as<String>();
      weather_icon = doc["weather"][0]["icon"].as<String>();

      Serial.printf("☁️ Code: %d | Text: %s | Icon: %s\n",
                    weather_code, weather_text.c_str(), weather_icon.c_str());
      // Cập nhật hiển thị icon (chỉ khi không sleep)
      if (!lcdSleeping) {
        tft.fillRect(78, 99, 50, 40, BLACK);
        iconthoitiet(78, 99, weather_code);
      }

      // Cập nhật hiển thị icon
      //tft.fillRect(78, 99, 50, 40, BLACK);
      //iconthoitiet(78, 99, weather_code);
    }
  } else {
    Serial.printf("❌ HTTP GET thất bại: %s\n", http.errorToString(httpCode).c_str());
  }
  http.end();
}



void iconthoitiet(int x, int y,int code) {     
  switch(code) {
    // Mua kem sam set
    case 200:
    case 201:
    case 202:
    case 211:
              tft.drawBitmap(x,y,lighting_rain,50,40,WHITE);
              break;
    // Sam set
    case 230:
    case 231:
    case 232:
    case 233:
              tft.drawBitmap(x,y,lighting,50,40,WHITE);
              break;
    // May + mua
    case 300:
    case 301:
    case 302:
    case 500:
    case 501:
    case 502:
    case 511:
    case 520:
    case 521:
    case 522:
    case 623:
              tft.drawBitmap(x,y,rain,50,40,WHITE);
              break;
    // Clear Sky
    case 800:
              if(gio <18 && gio>5)
                tft.drawBitmap(x,y,clear_sky,50,40,WHITE);
              else
                tft.drawBitmap(x,y,night,50,40,WHITE);  
              break;
    case 700:
    case 711:
    case 721:
    case 731:
    case 741:
    case 751:
    case 801:
    case 802:
    case 803:
              if(gio <18 && gio>5)
                tft.drawBitmap(x,y,clear_cloudy,50,40,WHITE);
              else
                tft.drawBitmap(x,y,night_cloud,50,40,WHITE);
              break;
    // Trời nhiều mây
    case 611:
    case 612:
    case 804:
              tft.drawBitmap(x,y,cloudy,50,40,WHITE);
              break;
  }
}
void printText(char *text, uint16_t color, int x, int y,int textSize ){
  tft.setCursor(x, y);
  tft.setTextColor(color);
  tft.setTextSize(textSize);
  tft.print(text);
}

